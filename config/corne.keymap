#define CONFIG_WIRELESS
#define ZMK_BASE_LAYER(name, LT, RT, LM, RM, LB, RB, LH, RH)                   \
    ZMK_LAYER(                                                                 \
        name,                                                                  \
                 LT RT                                                         \
                 LM RM                                                         \
                 LB RB                                                         \
        &kp LGUI LH RH &smart_mouse                                            \
    )

#include "includes/keys_36k.dtsi"
#include "includes/layout_36k.dtsi"

/{ chosen { zmk,physical-layout = &foostan_corne_5col_layout; }; };
