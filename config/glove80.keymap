// Board adapter for the Moergo Glove80 (80-key split).
// Serves the build targets: glove80_lh/nrf52840 and glove80_rh/nrf52840
//
// Entry point: places the shared 34-key base layout onto the Glove80's
// larger grid, filling extra keys with function keys / arrows.
#define CONFIG_WIRELESS
#define ZMK_BASE_LAYER(name, LT, RT, LM, RM, LB, RB, LH, RH)                                      \
    ZMK_LAYER(                                                                                    \
        name,                                                                                     \
        &kp F1    &kp F2 &kp F3 &kp F4 &kp F5               &kp F6 &kp F7 &kp F8 &kp F9 &kp F10   \
        &kp EQUAL &kp N1 &kp N2 &kp N3 &kp N4 &kp N5 &kp N6 &kp N7 &kp N8 &kp N9 &kp N0 &kp MINUS \
        &kp TAB              LT                                            RT           &kp BSPC  \
        &kp ESC              LM                                            RM           &none     \
        &none                LB &none  &none  &none  &none  &none &none    RB           &none     \
                                &none  &none &none                                                \
        &kp LEFT  &kp RIGHT  LH &none                             &none    RH    &kp UP &kp DOWN  \
                                                     &none  &none &none)

#include "zmk-helpers/key-labels/glove80.h"
#include "base.keymap"
