// Board adapter for the OLKB Planck Rev6 (48-key wired ortholinear).
// Serves the build target: planck@6.0.0//zmk
//
// Entry point: places the shared 34-key base layout onto the 4x12 grid,
// padding the inner columns with &none.
#define ZMK_BASE_LAYER(name, LT, RT, LM, RM, LB, RB, LH, RH)                   \
    ZMK_LAYER(                                                                 \
        name,                                                                  \
                             LT &none &none RT                                 \
                             LM &none &none RM                                 \
                             LB &none &none RB                                 \
        &none &none &kp LGUI LH &none &none RH &smart_mouse U_WH_D U_WH_U      \
    )

#include "zmk-helpers/key-labels/4x12_wide.h"
#include "base.keymap"
